/ {

};

&ddr_timing {
    phy_ddr3_odt = <PHY_DDR3_RON_RTT_112ohm>;
};

&dmc {
    system-status-freq = <
        /*system status         freq(KHz)*/
        SYS_STATUS_NORMAL       528000
        SYS_STATUS_REBOOT       450000
        SYS_STATUS_SUSPEND      194000
        SYS_STATUS_VIDEO_1080P  450000
        SYS_STATUS_BOOST        528000
        SYS_STATUS_ISP          666000
        SYS_STATUS_PERFORMANCE  666000
	>;
};

&dmc_opp_table {
    opp-666000000 {
        status = "disabled";
    };
};